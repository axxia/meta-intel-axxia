## meta-intel-axxia/conf/distro/include/intel-axxia-flags.inc
```bitbake
GCCPIE_axxiax86-64 = ""
GLIBCPIE_axxiax86-64 = ""
SECURITY_CFLAGS_remove_axxiax86-64 = "${SECURITY_PIE_CFLAGS}"

SECURITY_CFLAGS_pn-libgcc_axxiax86-64 = "${SECURITY_NOPIE_CFLAGS}"
SECURITY_CFLAGS_pn-glibc_axxiax86-64 = "${SECURITY_NOPIE_CFLAGS}"
SECURITY_CFLAGS_pn-glibc-initial_axxiax86-64 = "${SECURITY_NOPIE_CFLAGS}"
SECURITY_CFLAGS_pn-gcc-runtime_axxiax86-64 = "${SECURITY_NOPIE_CFLAGS}"
SECURITY_CFLAGS_pn-binutils_axxiax86-64 = "${SECURITY_NOPIE_CFLAGS}"
SECURITY_CFLAGS_pn-python_axxiax86-64 = "${SECURITY_NOPIE_CFLAGS}"
SECURITY_CFLAGS_pn-python3_axxiax86-64 = "${SECURITY_NOPIE_CFLAGS}"
```

## meta-intel-axxia/conf/distro/intel-axxia.conf
```bitbake
require conf/distro/poky.conf \
	${@bb.utils.contains('DISTRO_FEATURES', 'multilib', \
	'conf/multilib.conf', '', d)}

DISTRO = "intel-axxia"
DISTRO_NAME = "Intel Axxia Distro"
DISTRO_VERSION = "${RELEASE_VERSION}"
DISTRO_CODENAME = "intel-axxia"
SDK_VENDOR = "-intelaxxiasdk"
SDK_VERSION := "${RELEASE_VERSION}"

TARGET_VENDOR = "-intelaxxia"
RELEASE_VERSION ?= "snr_deliveryXX_linuxX_XX"

DISTRO_FEATURES_append = " pam virtualization kvm"

include conf/distro/include/intel-axxia-defaults.inc
include conf/distro/include/intel-axxia-custom.inc
include conf/distro/include/intel-axxia-flags.inc

# Enable SIMICSFS client support
#DISTRO_FEATURES_append = " simicsfs"

# Enable GCC8 feature for the previous version of gcc and glibc
#DISTRO_FEATURES_append = " gcc8"

# Disable building introspection data using qemu
DISTRO_FEATURES_BACKFILL_CONSIDERED = "gobject-introspection-data"
# Disable 'update_gio_module_cache 'and 'update_font_cache' postinstall
# intercept hooks because of missing qemu usermode support
GIO_MODULE_PACKAGES_forcevariable = ""
FONT_PACKAGES_forcevariable = ""

BBMASK_append = " ${@bb.utils.contains('DISTRO_FEATURES', 'simicsfs', '', \
			'simics-client* libmagicpipe*', d)} \
		  ${@oe.utils.conditional('ALTERNATIVE_KERNELS', '', \
			'meta-intel-axxia/recipes-kernel/lttng', '', d)}"

# Skip linux-yocto recipes from meta-virtualization to avoid warnings for
# duplicating inclusion of linux-yocto_virtualization.inc.
BBMASK_append = " meta-virtualization/recipes-kernel/linux"
```

## meta-intel-bsp/conf/machine/include/intel-axxia-common.inc
```bitbake
PREFERRED_PROVIDER_virtual/kernel ?= "linux-intel"
PREFERRED_VERSION_linux-intel ?= "5.10%"
PREFERRED_VERSION_linux-intel-rt ?= "5.10%"

EFI_PROVIDER ?= "grub-efi"

require conf/machine/include/meta-intel.inc
require conf/machine/include/intel-common-pkgarch.inc

MACHINE_FEATURES += "pcbios efi"
MACHINE_FEATURES += "intel-ucode ext3"

KARCH = "x86_64"
KERNEL_IMAGETYPE = "bzImage"
KEEPUIMAGE = "no"

IMAGE_FSTYPES += " ext2"
IMAGE_FSTYPES += " tar.gz"
IMAGE_FSTYPES += " iso"

IMAGE_FSTYPES += "wic"
WKS_FILE = "axxia-bootdisk-microcode.wks.in"
WKS_FILE_DEPENDS_append = " intel-microcode"

# QEMU usermode fails with invalid instruction error
MACHINE_FEATURES_BACKFILL_CONSIDERED_append = " qemu-usermode"
# Disable 'update_gio_module_cache 'and 'update_font_cache' postinstall
# intercept hooks because of missing qemu usermode support
GIO_MODULE_PACKAGES_forcevariable = ""
FONT_PACKAGES_forcevariable = ""
```

## meta-intel-bsp/conf/machine/include/tune-grr.inc
```bitbake
# Settings for Intel Grand Ridge CPU with 64-bit extensions, MOVBE, MMX, 
# SSE, SSE2, SSE3, SSSE3, SSE4.1, SSE4.2, POPCNT, AES, PREFETCHW, PCLMUL,
# RDRND, XSAVE, XSAVEC, XSAVES, XSAVEOPT, FSGSBASE, PTWRITE, RDPID, SGX,
# GFNI-SSE, CLWB, MOVDIRI, MOVDIR64B, CLDEMOTE, WAITPKG, ADCX, AVX, AVX2,
# BMI, BMI2, F16C, FMA, LZCNT, PCONFIG, PKU, VAES, VPCLMULQDQ, SERIALIZE,
# RESET, KL, WIDEKL, AVX-VNNI, AVXIFMA, AVXVNNIINT8, AVXNECONVERT,
# CMPCCXADD and RAOINT instruction set support. 
#
# This tune is recommended for the new Intel Grand Ridge CPU and beyond.
#

DEFAULTTUNE ?= "grr-64"

DEFAULTTUNE:virtclass-multilib-lib32 ?= "grr-32"
MULTILIBS = "multilib:lib32"

# Include the previous tune to pull in PACKAGE_EXTRA_ARCHS
require conf/machine/include/x86/tune-core2.inc

# Extra tune features
TUNEVALID[grr] = "Enable grr specific processor optimizations"
TUNE_CCARGS .= "${@bb.utils.contains('TUNE_FEATURES', 'grr', ' -march=tremont -mtune=tremont -mfpmath=sse -msse4.2', '', d)}"

# Extra tune selections
AVAILTUNES += "grr-32"
TUNE_FEATURES:tune-grr-32 = "${TUNE_FEATURES:tune-x86} grr"
BASE_LIB:tune-grr-32 = "lib"
TUNE_PKGARCH:tune-grr-32 = "grr-32"
PACKAGE_EXTRA_ARCHS:tune-grr-32 = "${PACKAGE_EXTRA_ARCHS:tune-core2-32} grr-32"
QEMU_EXTRAOPTIONS_grr-32 = " -cpu grandridge,check=false"

AVAILTUNES += "grr-64"
TUNE_FEATURES:tune-grr-64 = "${TUNE_FEATURES:tune-x86-64} grr"
BASE_LIB:tune-grr-64 = "lib64"
TUNE_PKGARCH:tune-grr-64 = "grr-64"
PACKAGE_EXTRA_ARCHS:tune-grr-64 = "${PACKAGE_EXTRA_ARCHS:tune-core2-64} grr-64"
QEMU_EXTRAOPTIONS_grr-64 = " -cpu grandridge,check=false"

AVAILTUNES += "grr-64-x32"
TUNE_FEATURES:tune-grr-64-x32 = "${TUNE_FEATURES:tune-x86-64-x32} grr"
BASE_LIB:tune-grr-64-x32 = "libx32"
TUNE_PKGARCH:tune-grr-64-x32 = "grr-64-x32"
PACKAGE_EXTRA_ARCHS:tune-grr-64-x32 = "${PACKAGE_EXTRA_ARCHS:tune-core2-64-x32} grr-64-x32"
QEMU_EXTRAOPTIONS_grr-64-x32 = " -cpu grandridge,check=false"
```

## meta-intel-bsp/conf/machine/include/tune-snr.inc
```bitbake
# Settings for Intel Snowridge CPU with 64-bit extensions, MMX, SSE, SSE2,
# SSE3, SSSE3, SSE4.1 and SSE4.2 instruction set support.
#
# This tune is recommended for the new Intel Snowridge CPU and beyond.
#

DEFAULTTUNE ?= "snr-64"

DEFAULTTUNE_virtclass-multilib-lib32 ?= "snr-32"
MULTILIBS = "multilib:lib32"

# Include the previous tune to pull in PACKAGE_EXTRA_ARCHS
require conf/machine/include/tune-core2.inc

# Extra tune features
TUNEVALID[snr] = "Enable snr specific processor optimizations"
TUNE_CCARGS .= "${@bb.utils.contains('TUNE_FEATURES', 'snr', ' -march=tremont -mtune=tremont -mfpmath=sse -msse4.2', '', d)}"

# Extra tune selections
AVAILTUNES += "snr-32"
TUNE_FEATURES_tune-snr-32 = "${TUNE_FEATURES_tune-x86} snr"
BASE_LIB_tune-snr-32 = "lib"
TUNE_PKGARCH_tune-snr-32 = "snr-32"
PACKAGE_EXTRA_ARCHS_tune-snr-32 = "${PACKAGE_EXTRA_ARCHS_tune-core2-32} snr-32"
QEMU_EXTRAOPTIONS_snr-32 = " -cpu Tremont,check=false"

AVAILTUNES += "snr-64"
TUNE_FEATURES_tune-snr-64 = "${TUNE_FEATURES_tune-x86-64} snr"
BASE_LIB_tune-snr-64 = "lib64"
TUNE_PKGARCH_tune-snr-64 = "snr-64"
PACKAGE_EXTRA_ARCHS_tune-snr-64 = "${PACKAGE_EXTRA_ARCHS_tune-core2-64} snr-64"
QEMU_EXTRAOPTIONS_snr-64 = " -cpu Tremont,check=false"

AVAILTUNES += "snr-64-x32"
TUNE_FEATURES_tune-snr-64-x32 = "${TUNE_FEATURES_tune-x86-64-x32} snr"
BASE_LIB_tune-snr-64-x32 = "libx32"
TUNE_PKGARCH_tune-snr-64-x32 = "snr-64-x32"
PACKAGE_EXTRA_ARCHS_tune-snr-64-x32 = "${PACKAGE_EXTRA_ARCHS_tune-core2-64-x32} snr-64-x32"
QEMU_EXTRAOPTIONS_snr-64-x32 = " -cpu Tremont,check=false"
```

## meta-intel-bsp/conf/machine/intel-axxia-grr.conf
```bitbake
#@TYPE: Machine
#@NAME: intel-axxia-grr
#@DESCRIPTION: Machine configuration for INTEL Axxia x86_64 Gen4 systems based on Intel Grand Ridge CPU with MOVBE, MMX, SSE, SSE2, SSE3, SSSE3, SSE4.1, SSE4.2, POPCNT, AES, PREFETCHW, PCLMUL, RDRND, XSAVE, XSAVEC, XSAVES, XSAVEOPT, FSGSBASE, PTWRITE, RDPID, SGX, GFNI-SSE, CLWB, MOVDIRI, MOVDIR64B, CLDEMOTE, WAITPKG, ADCX, AVX, AVX2, BMI, BMI2, F16C, FMA, LZCNT, PCONFIG, PKU, VAES, VPCLMULQDQ, SERIALIZE, HRESET, KL, WIDEKL, AVX-VNNI, AVXIFMA, AVXVNNIINT8, AVXNECONVERT, CMPCCXADD and RAOINT instruction set support. Supports a moderately wide range of drivers that should boot and be usable on "typical" hardware.

CPU_TYPE ?= "${@bb.utils.contains('DISTRO_FEATURES', 'gcc13', 'grandridge', 'nehalem', d)}"

require conf/machine/include/intel-axxia-common.inc
require conf/machine/include/tune-grr.inc
require ${@bb.utils.contains('DISTRO_FEATURES', 'qsp', \
	'conf/machine/include/tune-qsp.inc', '', d)}

SYSLINUX_OPTS = "serial 0 115200"
SERIAL_CONSOLES = "115200;ttyS0 115200;ttyS4"
SERIAL_CONSOLES_CHECK = "${SERIAL_CONSOLES}"

APPEND = "console=tty0 console=ttyS4,115200 reboot=w idle=poll intel-spi.writeable=1 intel_iommu=on iommu.passthrough=1"
```

## meta-intel-bsp/conf/machine/intel-axxia-snr.conf
```bitbake
#@TYPE: Machine
#@NAME: intel-axxia-snr
#@DESCRIPTION: Machine configuration for INTEL Axxia x86_64 Gen4 systems based on Intel Snow Ridge CPU with MMX, SSE, SSE2, SSE3, SSSE3, SSE4.1 and SSE4.2 instruction set support. Supports a moderately wide range of drivers that should boot and be usable on "typical" hardware.

require conf/machine/include/intel-axxia-common.inc
require conf/machine/include/tune-snr.inc

SYSLINUX_OPTS = "serial 0 115200"
SERIAL_CONSOLES = "115200;ttyS0 115200;ttyS4"
SERIAL_CONSOLES_CHECK = "${SERIAL_CONSOLES}"

APPEND = "console=tty0 console=ttyS4,115200 intel_iommu=on idle=poll"
```

## meta-intel-distro/conf/distro/include/intel-axxia-flags.inc
```bitbake
GCCPIE = ""
GLIBCPIE = ""
SECURITY_CFLAGS:remove = "${SECURITY_PIE_CFLAGS}"

SECURITY_CFLAGS:pn-libgcc = "${SECURITY_NOPIE_CFLAGS}"
SECURITY_CFLAGS:pn-glibc = "${SECURITY_NOPIE_CFLAGS}"
SECURITY_CFLAGS:pn-glibc-initial = "${SECURITY_NOPIE_CFLAGS}"
SECURITY_CFLAGS:pn-gcc-runtime = "${SECURITY_NOPIE_CFLAGS}"
SECURITY_CFLAGS:pn-binutils = "${SECURITY_NOPIE_CFLAGS}"
SECURITY_CFLAGS:pn-python = "${SECURITY_NOPIE_CFLAGS}"
SECURITY_CFLAGS:pn-python3 = "${SECURITY_NOPIE_CFLAGS}"
```
