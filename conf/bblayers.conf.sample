## conf/bblayers.conf.sample
```bitbake
# LAYER_CONF_VERSION is increased each time build/conf/bblayers.conf
# changes incompatibly
LCONF_VERSION = "6"

BBPATH = "${TOPDIR}"
BBFILES ?= ""

BBLAYERS ?= " \
  ##OEROOT##/meta \
  ##OEROOT##/meta-poky \
  ##OEROOT##/../meta-openembedded/meta-oe \
  ##OEROOT##/../meta-openembedded/meta-networking \
  ##OEROOT##/../meta-openembedded/meta-filesystems \
  ##OEROOT##/../meta-openembedded/meta-python \
  ##OEROOT##/../meta-virtualization \
  ##OEROOT##/../meta-intel \
  ##OEROOT##/../meta-intel-axxia \
  ##OEROOT##/../meta-intel-axxia/meta-intel-snr \
  "

BBLAYERS_NON_REMOVABLE ?= " \
  ##OEROOT##/meta \
  ##OEROOT##/meta-poky \
  ##OEROOT##/../meta-intel \
  ##OEROOT##/../meta-intel-axxia \
  ##OEROOT##/../meta-intel-axxia/meta-intel-snr \
  "
```

## conf/distro/axxia.conf
```bitbake
require conf/distro/poky.conf

DISTRO = "axxia"
DISTRO_NAME = "Axxia (Intel Axxia Distro)"
DISTRO_VERSION = "snr_delivery12_linux4_9.rc1"
DISTRO_CODENAME = "axxia"
SDK_VENDOR = "-axxiasdk"
SDK_VERSION := "snr_delivery12_linux4_9.rc1"

TARGET_VENDOR = "-axxia"

DISTRO_FEATURES_append = " pam systemd virtualization"
DISTRO_FEATURES_BACKFILL_CONSIDERED += "sysvinit"
VIRTUAL-RUNTIME_init_manager = "systemd"
VIRTUAL-RUNTIME_initscripts = "systemd-compat-units"

PREFERRED_VERSION_lxc ?= "2.0.6"
PREFERRED_RPROVIDER_iasl ?= "iasl"
PREFERRED_RPROVIDER_iasl-native ?= "iasl-native"

# Skip bbappends from meta-virtualization and meta-intel
# to skip fragments and layer specific setings for kernel
BBMASK = "meta-virtualization/recipes-kernel/linux"
BBMASK .= "|meta-intel/common/recipes-kernel/linux"
```

## conf/distro/include/intel-axxia-defaults.inc
```bitbake
PREFERRED_RPROVIDER_iasl ?= "iasl"
PREFERRED_RPROVIDER_iasl-native ?= "iasl-native"

PREFERRED_VERSION_rpcbind ?= "0.2.3"

GCC_VERSION = "${@bb.utils.contains('DISTRO_FEATURES', 'gcc9', '9%', '8%', d)}"
PREFERRED_VERSION_gcc ?= "${GCC_VERSION}"
PREFERRED_VERSION_gcc-runtime ?= "${GCC_VERSION}"
PREFERRED_VERSION_gcc-sanitizers ?= "${GCC_VERSION}"
PREFERRED_VERSION_gcc-source ?= "${GCC_VERSION}"
PREFERRED_VERSION_gcc-runtime ?= "${GCC_VERSION}"
PREFERRED_VERSION_gcc-cross-${TARGET_ARCH} ?= "${GCC_VERSION}"
PREFERRED_VERSION_gcc-crosssdk-${SDK_SYS} ?= "${GCC_VERSION}"
PREFERRED_VERSION_gcc-cross-canadian-${TRANSLATED_TARGET_ARCH} ?= "${GCC_VERSION}"
PREFERRED_VERSION_libgcc ?= "${GCC_VERSION}"
PREFERRED_VERSION_libgcc-initial ?= "${GCC_VERSION}"
PREFERRED_VERSION_libgfortran ?= "${GCC_VERSION}"

GLIBC_VERSION = "${@bb.utils.contains('DISTRO_FEATURES', 'gcc9', '2.29', '2.28', d)}"
PREFERRED_VERSION_glibc ?= "${GLIBC_VERSION}"
PREFERRED_VERSION_glibc-scripts ?= "${GLIBC_VERSION}"
PREFERRED_VERSION_glibc-mtrace ?= "${GLIBC_VERSION}"
PREFERRED_VERSION_glibc-locale ?= "${GLIBC_VERSION}"
PREFERRED_VERSION_cross-localedef-native ?= "${GLIBC_VERSION}"

PREFERRED_VERSION_libxcrypt ?= "${@bb.utils.contains('DISTRO_FEATURES', 'gcc9','4.4%', '4.1%', d)}"
```

## conf/distro/intel-axxia.conf
```bitbake
require conf/distro/poky.conf

DISTRO = "intel-axxia"
DISTRO_NAME = "Intel Axxia Distro"
DISTRO_VERSION = "${RELEASE_VERSION}"
DISTRO_CODENAME = "intel-axxia"
SDK_VENDOR = "-intelaxxiasdk"
SDK_VERSION := "${RELEASE_VERSION}"

TARGET_VENDOR = "-intelaxxia"
RELEASE_VERSION ?= "snr_deliveryXX_linuxX_XX"

DISTRO_FEATURES_append = " pam systemd virtualization kvm"
DISTRO_FEATURES_BACKFILL_CONSIDERED_append = " sysvinit"
VIRTUAL-RUNTIME_init_manager = "systemd"
VIRTUAL-RUNTIME_initscripts = "systemd-compat-units"

include conf/distro/include/intel-axxia-defaults.inc

# Enable SIMICSFS client support
#DISTRO_FEATURES_append = " simicsfs"

# Enable GCC9 feature for a newer version of gcc and glibc
#DISTRO_FEATURES_append = " gcc9"

BBMASK_append = " ${@bb.utils.contains('DISTRO_FEATURES', 'simicsfs', '', \
				       'simics-client* libmagicpipe*', d)}"

# Skip linux-yocto recipes from meta-virtualization to avoid warnings for
# duplicating inclusion of linux-yocto_virtualization.inc.
BBMASK_append = " meta-virtualization/recipes-kernel/linux"
```

## conf/layer.conf
```bitbake
# We have a conf and classes directory, add to BBPATH
BBPATH .= ":${LAYERDIR}"

# We have recipes-* directories, add to BBFILES
BBFILES += "${LAYERDIR}/recipes-*/*/*.bb \
	${LAYERDIR}/recipes-*/*/*.bbappend"

BBFILE_COLLECTIONS += "axxia"
BBFILE_PATTERN_axxia := "^${LAYERDIR}/"
BBFILE_PRIORITY_axxia = "5"

LAYERDEPENDS_axxia = " \
	core \
	openembedded-layer \
	networking-layer \
	meta-python \
	virtualization-layer \
	intel \
"
```

## conf/local.conf.sample
```bitbake
MACHINE = "axxiax86-64"

# System where the image will run: simics, frio
RUNTARGET = "simics"

# Kernel providers: linux-yocto, linux-yocto-rt, linux-axxia, linux-axxia-rt
PREFERRED_PROVIDER_virtual/kernel = "linux-yocto"

# Kernel versions: 4.9, 4.12
PREFERRED_VERSION_linux-yocto = "4.9%"

# Add simicsfs-client support (sources should be in meta-intel-axxia/download)
SIMICSFS = "no"

BB_NUMBER_THREADS = "12"
PARALLEL_MAKE = "-j 12"

# Assume directories were created at the same level with poky
# DL_DIR = "##OEROOT##/../downloads"
# SSTATE_DIR = "##OEROOT##/../sstate_cache"

DISTRO = "intel-axxia"
PACKAGE_CLASSES ?= "package_rpm"
EXTRA_IMAGE_FEATURES = "debug-tweaks"
USER_CLASSES ?= "buildstats image-mklibs image-prelink"
PATCHRESOLVE = "noop"
BB_DISKMON_DIRS = "\
    STOPTASKS,${TMPDIR},1G,100K \
    STOPTASKS,${DL_DIR},1G,100K \
    STOPTASKS,${SSTATE_DIR},1G,100K \
    STOPTASKS,/tmp,100M,100K \
    ABORT,${TMPDIR},100M,1K \
    ABORT,${DL_DIR},100M,1K \
    ABORT,${SSTATE_DIR},100M,1K \
    ABORT,/tmp,10M,1K"
PACKAGECONFIG_append_pn-qemu-native = " sdl"
PACKAGECONFIG_append_pn-nativesdk-qemu = " sdl"
CONF_VERSION = "1"

# For more options check meta-axxia layer for README and 
# conf/local.conf.sample.extended
```

## conf/machine/axxiaarm.conf
```bitbake
#@TYPE: Machine
#@NAME: axxiaarm
#@DESCRIPTION: Machine configuration for INTEL Axxia ARM systems

PREFERRED_PROVIDER_virtual/kernel ?= "linux-yocto-rt"
PREFERRED_VERSION_linux-yocto ?= "4.9%"

MACHINE_FEATURES += "ext3"

# Default tune will be for 5500 board: cortexa17 (armv7a)
CHIPSET ?= "5500"
TUNE_X9 = "conf/machine/include/tune-cortexa57.inc"
TUNE_XLF = "conf/machine/include/tune-cortexa53.inc"
TUNE_5500 = "conf/machine/include/tune-cortexa15.inc"
require ${TUNE_${CHIPSET}}

# Armv8a SoCs supports 32-bit and 64-bit states.
# Set default to 32-bit state for axxiarm machine
DEFAULTTUNE_X9 = "cortexa57_32-crypto"
DEFAULTTUNE_XLF = "cortexa53_32-crypto"
DEFAULTTUNE_5500 = "cortexa15-neon"
DEFAULTTUNE ?= "${@bb.utils.contains('CHIPSET', 'X9', '${DEFAULTTUNE_X9}', \
		bb.utils.contains('CHIPSET', 'XLF', '${DEFAULTTUNE_XLF}', \
		'${DEFAULTTUNE_5500}', d), d)}"

KARCH = "arm"
KERNEL_IMAGETYPE = "zImage"
UBOOT_ENTRYPOINT = "0x400000"
KEEPUIMAGE = "no"

IMAGE_FSTYPES += "ext2"
IMAGE_FSTYPES += "tar.gz"

SERIAL_CONSOLE = "9600 ttyAMA0"
```

## conf/machine/axxiaarm64.conf
```bitbake
#@TYPE: Machine
#@NAME: axxiaarm64
#@DESCRIPTION: Machine configuration for INTEL Axxia ARM64 systems

PREFERRED_VERSION_linux-yocto ?= "4.1%"
#PREFERRED_VERSION_u-boot-axxia ?= "2013.01.01%"
PREFERRED_PROVIDER_virtual/kernel ?= "linux-yocto"
#PREFERRED_PROVIDER_virtual/bootloader ?= "u-boot-axxia"

#EXTRA_IMAGEDEPENDS = "u-boot-axxia"

MACHINE_FEATURES += "ext3"

MACHINE_EXTRA_RRECOMMENDS += ""

# Default tune will be for X9 board: cortexa57
CHIPSET ?= "X9"
TUNE_X9 = "conf/machine/include/tune-cortexa57.inc"
TUNE_XLF = "conf/machine/include/tune-cortexa53.inc"
require ${TUNE_${CHIPSET}}

# Armv8a SoCs supports 32-bit and 64-bit states. Set default to 32-bit state for axxiarm machine
DEFAULTTUNE_X9 = "cortexa57_64-crypto"
DEFAULTTUNE_XLF = "cortexa53_64-crypto"
DEFAULTTUNE ?= "${@bb.utils.contains('CHIPSET', 'XLF', '${DEFAULTTUNE_XLF}', '${DEFAULTTUNE_X9}', d)}"

KARCH = "arm64"
KERNEL_IMAGETYPE = "Image"
UBOOT_ENTRYPOINT = "0x400000"
KEEPUIMAGE = "no"

IMAGE_FSTYPES += "ext2"
IMAGE_FSTYPES += "tar.gz"

SERIAL_CONSOLE = "9600 ttyAMA0"

FORTRAN_forcevariable = ",fortran"
```

## conf/machine/axxiapowerpc.conf
```bitbake
#@TYPE: Machine
#@NAME: axxiapowerpc
#@DESCRIPTION: Machine configuration for the INTEL Axxia PowerPC systems

PREFERRED_PROVIDER_virtual/kernel ?= "linux-yocto"
PREFERRED_PROVIDER_virtual/bootloader ?= "u-boot-axxia"
PREFERRED_VERSION_linux-yocto ?= "3.14%"
PREFERRED_VERSION_u-boot-axxia ?= "2010.03%"

EXTRA_IMAGEDEPENDS = "u-boot-axxia"

require conf/machine/include/tune-ppc476.inc

KARCH = "powerpc"
KERNEL_IMAGETYPE = "uImage"
UBOOT_ENTRYPOINT = "0x400000"
KEEPUIMAGE = "no"

IMAGE_FSTYPES += "ext2"
IMAGE_FSTYPES += "tar.gz"

SERIAL_CONSOLE = "115200 ttyS0"
```

## conf/machine/axxiax86-64.conf
```bitbake
#@TYPE: Machine
#@NAME: axxiax86-64
#@DESCRIPTION: Machine configuration for INTEL Axxia x86_64 systems (Intel Core i7 CPU and later) with MMX, SSE, SSE2, SSE3, and SSSE3 instruction set support. Supports a moderately wide range of drivers that should boot and be usable on "typical" hardware.

PREFERRED_VERSION_linux-yocto ?= "4.9%"
PREFERRED_PROVIDER_virtual/kernel ?= "linux-yocto"
PREFERRED_VERSION_nfs-utils ?= "1.3.1"
PREFERRED_VERSION_lxc ?= "2.0.6"

require conf/machine/intel-corei7-64.conf

MACHINEOVERRIDES =. "intel-x86-common:"

MACHINE_FEATURES += "ext3"

KARCH = "x86_64"
KERNEL_IMAGETYPE = "bzImage"
KEEPUIMAGE = "no"

APPEND = "rootwait console=ttyS5,115200 console=tty0 intel_iommu=on"

IMAGE_FSTYPES += "hddimg"
IMAGE_FSTYPES += "ext2"
IMAGE_FSTYPES += "tar.gz"

MACHINE_ESSENTIAL_EXTRA_RDEPENDS += "kernel-module-simicsfs"
KERNEL_MODULE_AUTOLOAD += " simicsfs"
IMAGE_INSTALL_append = " simicsfs-mod"

# For axxia kernels skip bbappends from meta-virtualization and meta-intel to skip fragments and layer specific setings for kernel
BBMASK = "meta-virtualization/recipes-kernel/linux"
BBMASK .= "|meta-intel/common/recipes-kernel/linux"
```

## conf/machine/include/arm/arch-armv8a.inc
```bitbake
TUNEVALID[arm] = "Enable ARM instruction set"
TUNEVALID[aarch32] = "Enable instructions for 32bit state for ARMv8-a (AArch32)"
TUNEVALID[aarch64] = "Enable instructions for 64bit state for ARMv8-a (AArch64)"
TUNECONFLICTS[aarch32] = "armv4 armv5 armv6 armv7 armv7a armv7ve"

require conf/machine/include/arm/arch-arm.inc
require conf/machine/include/arm/feature-arm-neon.inc
require conf/machine/include/arm/feature-arm-vfp.inc
require conf/machine/include/arm/feature-arm-thumb.inc

TUNEVALID[crypto] = "Enable ARMv8 crypto extension."
TUNE_CCARGS .= "${@bb.utils.contains('TUNE_FEATURES', 'aarch64', bb.utils.contains('TUNE_FEATURES', 'crypto', ' -march=armv8-a+crypto', ' -march=armv8-a', d), '', d)}"
TUNE_CCARGS .= "${@bb.utils.contains('TUNE_FEATURES', 'aarch32', bb.utils.contains_any('TUNE_FEATURES', [ 'cortexa53', 'cortexa57' ], '', ' -march=armv8-a', d), '', d)}"

TUNEVALID[fp-armv8] = "Enable ARMv8 Vector Floating Point unit."
TUNE_CCARGS_MFPU .= "${@bb.utils.contains('TUNE_FEATURES', 'fp-armv8', ' fp-armv8', '', d)}"
TUNE_CCARGS_MFPU .= "${@bb.utils.contains('TUNE_FEATURES', [ 'fp-armv8', 'neon' ], ' neon-fp-armv8', '', d)}"
TUNE_CCARGS_MFPU .= "${@bb.utils.contains('TUNE_FEATURES', [ 'fp-armv8', 'neon', 'crypto' ], ' crypto-neon-fp-armv8', '', d)}"

MACHINEOVERRIDES =. "${@bb.utils.contains('TUNE_FEATURES', 'aarch32', 'aarch32:', '' ,d)}"
MACHINEOVERRIDES =. "${@bb.utils.contains('TUNE_FEATURES', 'aarch64', 'aarch64:', '' ,d)}"


# AArch32 Little Endian base configs
AVAILTUNES += "aarch32 aarch32t aarch32-crypto aarch32t-crypto"
ARMPKGARCH_tune-aarch32         ?= "aarch32"
ARMPKGARCH_tune-aarch32t        ?= "aarch32"
ARMPKGARCH_tune-aarch32-crypto  ?= "aarch32"
ARMPKGARCH_tune-aarch32t-crypto ?= "aarch32"
TUNE_FEATURES_tune-aarch32         = "arm aarch32 neon fp-armv8 callconvention-hard"
TUNE_FEATURES_tune-aarch32t        = "${TUNE_FEATURES_tune-aarch32} thumb"
TUNE_FEATURES_tune-aarch32-crypto  = "${TUNE_FEATURES_tune-aarch32} crypto"
TUNE_FEATURES_tune-aarch32t-crypto = "${TUNE_FEATURES_tune-aarch32-crypto} thumb"
PACKAGE_EXTRA_ARCHS_tune-aarch32         = "aarch32hf-neon-fp-armv8"
PACKAGE_EXTRA_ARCHS_tune-aarch32t        = "${PACKAGE_EXTRA_ARCHS_tune-aarch32} aarch32t2hf-neon-fp-armv8"
PACKAGE_EXTRA_ARCHS_tune-aarch32-crypto  = "${PACKAGE_EXTRA_ARCHS_tune-aarch32} aarch32hf-crypto-neon-fp-armv8"
PACKAGE_EXTRA_ARCHS_tune-aarch32t-crypto = "${PACKAGE_EXTRA_ARCHS_tune-aarch32-crypto} aarch32t2hf-crypto-neon-fp-armv8"

# AArch32 Big Endian base configs
AVAILTUNES += "aarch32b aarch32tb aarch32b-crypto aarch32tb-crypto"
ARMPKGARCH_tune-aarch32b         ?= "aarch32"
ARMPKGARCH_tune-aarch32tb        ?= "aarch32"
ARMPKGARCH_tune-aarch32b-crypto  ?= "aarch32"
ARMPKGARCH_tune-aarch32tb-crypto ?= "aarch32"
TUNE_FEATURES_tune-aarch32b         = "${TUNE_FEATURES_tune-aarch32}         bigendian"
TUNE_FEATURES_tune-aarch32tb        = "${TUNE_FEATURES_tune-aarch32t}        bigendian"
TUNE_FEATURES_tune-aarch32b-crypto  = "${TUNE_FEATURES_tune-aarch32-crypto}  bigendian"
TUNE_FEATURES_tune-aarch32tb-crypto = "${TUNE_FEATURES_tune-aarch32t-crypto} bigendian"
PACKAGE_EXTRA_ARCHS_tune-aarch32b         = "aarch32hfb-neon-fp-armv8"
PACKAGE_EXTRA_ARCHS_tune-aarch32tb        = "${PACKAGE_EXTRA_ARCHS_tune-aarch32b} aarch32t2hfb-neon-fp-armv8"
PACKAGE_EXTRA_ARCHS_tune-aarch32b-crypto  = "${PACKAGE_EXTRA_ARCHS_tune-aarch32b} aarch32hfb-crypto-neon-fp-armv8"
PACKAGE_EXTRA_ARCHS_tune-aarch32tb-crypto = "${PACKAGE_EXTRA_ARCHS_tune-aarch32b-crypto} aarch32t2hfb-crypto-neon-fp-armv8"


# AArch64 Little Endian base configs
AVAILTUNES += "aarch64 aarch64-crypto"
ARMPKGARCH_tune-aarch64        ?= "aarch64"
ARMPKGARCH_tune-aarch64-crypto ?= "aarch64"
TUNE_FEATURES_tune-aarch64         = "aarch64"
TUNE_FEATURES_tune-aarch64-crypto  = "${TUNE_FEATURES_tune-aarch64} crypto"
PACKAGE_EXTRA_ARCHS_tune-aarch64        = "aarch64"
PACKAGE_EXTRA_ARCHS_tune-aarch64-crypto = "${PACKAGE_EXTRA_ARCHS_tune-aarch64} aarch64-crypto"
BASE_LIB_tune-aarch64        = "lib64"
BASE_LIB_tune-aarch64-crypto = "${BASE_LIB_tune-aarch64}"

# AArch64 Big Endian base configs
AVAILTUNES += "aarch64_be aarch64_be-crypto"
ARMPKGARCH_tune-aarch64_be        ?= "aarch64_be"
ARMPKGARCH_tune-aarch64_be-crypto ?= "aarch64_be"
TUNE_FEATURES_tune-aarch64_be        = "${TUNE_FEATURES_tune-aarch64}        bigendian"
TUNE_FEATURES_tune-aarch64_be-crypto = "${TUNE_FEATURES_tune-aarch64-crypto} bigendian"
PACKAGE_EXTRA_ARCHS_tune-aarch64_be        = "aarch64_be"
PACKAGE_EXTRA_ARCHS_tune-aarch64_be-crypto = "${PACKAGE_EXTRA_ARCHS_tune-aarch64_be} aarch64_be-crypto"
BASE_LIB_tune-aarch64_be        = "${BASE_LIB_tune-aarch64}"
BASE_LIB_tune-aarch64_be-crypto = "${BASE_LIB_tune-aarch64}"


ARMPKGSFX_ENDIAN_64 = "${@bb.utils.contains('TUNE_FEATURES', 'bigendian', '_be', '', d)}"
TUNE_ARCH_64 = "aarch64${ARMPKGSFX_ENDIAN_64}"
TUNE_PKGARCH_64 = "aarch64${ARMPKGSFX_ENDIAN_64}"
ABIEXTENSION_64 = ""
TARGET_FPU_64 = ""

# Duplicated from arch-arm.inc
TUNE_ARCH_32 = "${@bb.utils.contains('TUNE_FEATURES', 'bigendian', 'armeb', 'arm', d)}"
TUNE_PKGARCH_32 = "${ARMPKGARCH}${ARMPKGSFX_THUMB}${ARMPKGSFX_DSP}${ARMPKGSFX_EABI}${ARMPKGSFX_ENDIAN}${ARMPKGSFX_FPU}"
ABIEXTENSION_32 = "eabi"
TARGET_FPU_32 = "${@d.getVar('TUNE_CCARGS_MFLOAT', True) or 'soft'}"

TUNE_ARCH = "${@bb.utils.contains('TUNE_FEATURES', 'aarch64', '${TUNE_ARCH_64}', '${TUNE_ARCH_32}' ,d)}"
TUNE_PKGARCH = "${@bb.utils.contains('TUNE_FEATURES', 'aarch64', '${TUNE_PKGARCH_64}', '${TUNE_PKGARCH_32}' ,d)}"
ABIEXTENSION = "${@bb.utils.contains('TUNE_FEATURES', 'aarch64', '${ABIEXTENSION_64}', '${ABIEXTENSION_32}' ,d)}"
TARGET_FPU = "${@bb.utils.contains('TUNE_FEATURES', 'aarch64', '${TARGET_FPU_64}', '${TARGET_FPU_32}' ,d)}"
```
