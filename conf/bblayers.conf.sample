## conf/machine/include/tune-cortexa15.inc
```bitbake
DEFAULTTUNE ?= "cortexa15-neon"

require conf/machine/include/arm/arch-armv7a.inc

TUNEVALID[cortexa15] = "Enable Cortex-A15 specific processor optimizations"
TUNE_CCARGS += "${@bb.utils.contains("TUNE_FEATURES", "cortexa15", "-mtune=cortex-a15", "", d)}"

# Little Endian base configs
AVAILTUNES += "cortexa15 cortexa15t cortexa15-neon"
ARMPKGARCH_tune-cortexa15 ?= "cortexa15"
ARMPKGARCH_tune-cortexa15t ?= "cortexa15"
ARMPKGARCH_tune-cortexa15-neon ?= "cortexa15"

TUNE_FEATURES_tune-cortexa15 = "${TUNE_FEATURES_tune-armv7a} cortexa15 vfp neon"
TUNE_FEATURES_tune-cortexa15t = "${TUNE_FEATURES_tune-armv7at} cortexa15"
TUNE_FEATURES_tune-cortexa15-neon = "${TUNE_FEATURES_tune-armv7a-neon} cortexa15"
PACKAGE_EXTRA_ARCHS_tune-cortexa15 = "${PACKAGE_EXTRA_ARCHS_tune-armv7a} cortexa15-vfp-neon"
PACKAGE_EXTRA_ARCHS_tune-cortexa15t = "${PACKAGE_EXTRA_ARCHS_tune-armv7at} cortexa15-vfp-neon"
PACKAGE_EXTRA_ARCHS_tune-cortexa15-neon = "${PACKAGE_EXTRA_ARCHS_tune-armv7a-neon} cortexa15-vfp-neon"

# VFP Tunes
AVAILTUNES += "cortexa15hf cortexa15thf cortexa15hf-neon"
ARMPKGARCH_tune-cortexa15hf ?= "cortexa15"
ARMPKGARCH_tune-cortexa15thf ?= "cortexa15"
ARMPKGARCH_tune-cortexa15hf-neon?= "cortexa15"

TUNE_FEATURES_tune-cortexa15hf ?= "${TUNE_FEATURES_tune-armv7ahf} cortexa15"
TUNE_FEATURES_tune-cortexa15thf ?= "${TUNE_FEATURES_tune-armv7athf} cortexa15"
TUNE_FEATURES_tune-cortexa15hf-neon ?= "${TUNE_FEATURES_tune-armv7ahf-neon} cortexa15"
PACKAGE_EXTRA_ARCHS_tune-cortexa15hf = "${PACKAGE_EXTRA_ARCHS_tune-armv7ahf} cortexa15"
PACKAGE_EXTRA_ARCHS_tune-cortexa15thf = "${PACKAGE_EXTRA_ARCHS_tune-armv7athf} cortexa15"
PACKAGE_EXTRA_ARCHS_tune-cortexa15hf-neon = "${PACKAGE_EXTRA_ARCHS_tune-armv7ahf-neon} cortexa15"
```

## conf/machine/include/tune-cortexa53.inc
```bitbake
require conf/machine/include/arm/arch-armv8a.inc

TUNEVALID[cortexa53] = "Enable Cortex-A53 specific processor optimizations"
TUNE_CCARGS .= "${@bb.utils.contains('TUNE_FEATURES', 'cortexa53', bb.utils.contains('TUNE_FEATURES', [ 'crypto', 'aarch64' ], ' -mcpu=cortex-a53+crypto', ' -mcpu=cortex-a53', d), '', d)}"
TUNE_CCARGS .= "${@bb.utils.contains('TUNE_FEATURES', 'cortexa53', ' -mtune=cortex-a53', '', d)}"

# AArch64 Little Endian base configs
AVAILTUNES += "cortexa53_64 cortexa53_64-crypto"
ARMPKGARCH_tune-cortexa53_64        ?= "cortexa53"
ARMPKGARCH_tune-cortexa53_64-crypto ?= "cortexa53"
TUNE_FEATURES_tune-cortexa53_64        = "${TUNE_FEATURES_tune-aarch64}        cortexa53"
TUNE_FEATURES_tune-cortexa53_64-crypto = "${TUNE_FEATURES_tune-aarch64-crypto} cortexa53"
PACKAGE_EXTRA_ARCHS_tune-cortexa53_64        = "${PACKAGE_EXTRA_ARCHS_tune-aarch64} cortexa53"
PACKAGE_EXTRA_ARCHS_tune-cortexa53_64-crypto = "${PACKAGE_EXTRA_ARCHS_tune-aarch64-crypto} cortexa53-crypto"
BASE_LIB_tune-cortexa53_64        = "${BASE_LIB_tune-aarch64}"
BASE_LIB_tune-cortexa53_64-crypto = "${BASE_LIB_tune-aarch64}"

# Aarch64 Big Endian base configs
AVAILTUNES += "cortexa53_64_be cortexa53_64_be-crypto"
ARMPKGARCH_tune-cortexa53_64_be        ?= "cortexa53"
ARMPKGARCH_tune-cortexa53_64_be-crypto ?= "cortexa53"
TUNE_FEATURES_tune-cortexa53_64_be        = "${TUNE_FEATURES_tune-aarch64_be}        cortexa53"
TUNE_FEATURES_tune-cortexa53_64_be-crypto = "${TUNE_FEATURES_tune-aarch64_be-crypto} cortexa53"
PACKAGE_EXTRA_ARCHS_tune-cortexa53_64_be        = "${PACKAGE_EXTRA_ARCHS_tune-aarch64_be} cortexa53_be"
PACKAGE_EXTRA_ARCHS_tune-cortexa53_64_be-crypto = "${PACKAGE_EXTRA_ARCHS_tune-aarch64_be-crypto} cortexa53_be-crypto"
BASE_LIB_tune-cortexa53_64_be        = "${BASE_LIB_tune-aarch64}"
BASE_LIB_tune-cortexa53_64_be-crypto = "${BASE_LIB_tune-aarch64}"


# Aarch32 Little Endian base configs
AVAILTUNES += "cortexa53_32 cortexa53_32t cortexa53_32-crypto cortexa53_32t-crypto"
ARMPKGARCH_tune-cortexa53_32         ?= "cortexa53"
ARMPKGARCH_tune-cortexa53_32t        ?= "cortexa53"
ARMPKGARCH_tune-cortexa53_32-crypto  ?= "cortexa53"
ARMPKGARCH_tune-cortexa53_32t-crypto ?= "cortexa53"
TUNE_FEATURES_tune-cortexa53_32         = "${TUNE_FEATURES_tune-aarch32}         cortexa53"
TUNE_FEATURES_tune-cortexa53_32t        = "${TUNE_FEATURES_tune-aarch32t}        cortexa53"
TUNE_FEATURES_tune-cortexa53_32-crypto  = "${TUNE_FEATURES_tune-aarch32-crypto}  cortexa53"
TUNE_FEATURES_tune-cortexa53_32t-crypto = "${TUNE_FEATURES_tune-aarch32t-crypto} cortexa53"
PACKAGE_EXTRA_ARCHS_tune-cortexa53_32         = "${PACKAGE_EXTRA_ARCHS_tune-aarch32} cortexa53hf-neon-fp-armv8"
PACKAGE_EXTRA_ARCHS_tune-cortexa53_32t        = "${PACKAGE_EXTRA_ARCHS_tune-cortexa53_32} cortexa53t2hf-neon-fp-armv8"
PACKAGE_EXTRA_ARCHS_tune-cortexa53_32-crypto  = "${PACKAGE_EXTRA_ARCHS_tune-cortexa53_32} cortexa53hf-crypto-neon-fp-armv8"
PACKAGE_EXTRA_ARCHS_tune-cortexa53_32t-crypto = "${PACKAGE_EXTRA_ARCHS_tune-cortexa53_32-crypto} cortexa53t2hf-crypto-neon-fp-armv8"

# AArch32 Big Endian base configs
AVAILTUNES += "cortexa53_32b cortexa53_32tb cortexa53_32b-crypto cortexa53_32tb-crypto"
ARMPKGARCH_tune-cortexa53_32b         ?= "cortexa53"
ARMPKGARCH_tune-cortexa53_32tb        ?= "cortexa53"
ARMPKGARCH_tune-cortexa53_32b-crypto  ?= "cortexa53"
ARMPKGARCH_tune-cortexa53_32tb-crypto ?= "cortexa53"
TUNE_FEATURES_tune-cortexa53_32b         = "${TUNE_FEATURES_tune-aarch32b}         cortexa53"
TUNE_FEATURES_tune-cortexa53_32tb        = "${TUNE_FEATURES_tune-aarch32tb}        cortexa53"
TUNE_FEATURES_tune-cortexa53_32b-crypto  = "${TUNE_FEATURES_tune-aarch32b-crypto}  cortexa53"
TUNE_FEATURES_tune-cortexa53_32tb-crypto = "${TUNE_FEATURES_tune-aarch32tb-crypto} cortexa53"
PACKAGE_EXTRA_ARCHS_tune-cortexa53_32b         = "${PACKAGE_EXTRA_ARCHS_tune-aarch32b} cortexa53hfb-neon-fp-armv8"
PACKAGE_EXTRA_ARCHS_tune-cortexa53_32tb        = "${PACKAGE_EXTRA_ARCHS_tune-cortexa53_32b} cortexa53t2hfb-neon-fp-armv8"
PACKAGE_EXTRA_ARCHS_tune-cortexa53_32b-crypto  = "${PACKAGE_EXTRA_ARCHS_tune-cortexa53_32b} cortexa53hfb-crypto-neon-fp-armv8"
PACKAGE_EXTRA_ARCHS_tune-cortexa53_32tb-crypto = "${PACKAGE_EXTRA_ARCHS_tune-cortexa53_32b-crypto} cortexa53t2hfb-crypto-neon-fp-armv8"
```

## conf/machine/include/tune-cortexa57.inc
```bitbake
require conf/machine/include/arm/arch-armv8a.inc

TUNEVALID[cortexa57] = "Enable Cortex-A57 specific processor optimizations"
TUNE_CCARGS .= "${@bb.utils.contains('TUNE_FEATURES', 'cortexa57', bb.utils.contains('TUNE_FEATURES', [ 'crypto', 'aarch64' ], ' -mcpu=cortex-a57+crypto', ' -mcpu=cortex-a57', d), '', d)}"
TUNE_CCARGS .= "${@bb.utils.contains('TUNE_FEATURES', 'cortexa57', ' -mtune=cortex-a57', '', d)}"

# AArch64 Little Endian base configs
AVAILTUNES += "cortexa57_64 cortexa57_64-crypto"
ARMPKGARCH_tune-cortexa57_64        ?= "cortexa57"
ARMPKGARCH_tune-cortexa57_64-crypto ?= "cortexa57"
TUNE_FEATURES_tune-cortexa57_64        = "${TUNE_FEATURES_tune-aarch64}        cortexa57"
TUNE_FEATURES_tune-cortexa57_64-crypto = "${TUNE_FEATURES_tune-aarch64-crypto} cortexa57"
PACKAGE_EXTRA_ARCHS_tune-cortexa57_64        = "${PACKAGE_EXTRA_ARCHS_tune-aarch64} cortexa57"
PACKAGE_EXTRA_ARCHS_tune-cortexa57_64-crypto = "${PACKAGE_EXTRA_ARCHS_tune-aarch64-crypto} cortexa57-crypto"
BASE_LIB_tune-cortexa57_64        = "${BASE_LIB_tune-aarch64}"
BASE_LIB_tune-cortexa57_64-crypto = "${BASE_LIB_tune-aarch64}"

# Aarch64 Big Endian base configs
AVAILTUNES += "cortexa57_64_be cortexa57_64_be-crypto"
ARMPKGARCH_tune-cortexa57_64_be        ?= "cortexa57"
ARMPKGARCH_tune-cortexa57_64_be-crypto ?= "cortexa57"
TUNE_FEATURES_tune-cortexa57_64_be        = "${TUNE_FEATURES_tune-aarch64_be}        cortexa57"
TUNE_FEATURES_tune-cortexa57_64_be-crypto = "${TUNE_FEATURES_tune-aarch64_be-crypto} cortexa57"
PACKAGE_EXTRA_ARCHS_tune-cortexa57_64_be        = "${PACKAGE_EXTRA_ARCHS_tune-aarch64_be} cortexa57_be"
PACKAGE_EXTRA_ARCHS_tune-cortexa57_64_be-crypto = "${PACKAGE_EXTRA_ARCHS_tune-aarch64_be-crypto} cortexa57_be-crypto"
BASE_LIB_tune-cortexa57_64_be        = "${BASE_LIB_tune-aarch64}"
BASE_LIB_tune-cortexa57_64_be-crypto = "${BASE_LIB_tune-aarch64}"


# Aarch32 Little Endian base configs
AVAILTUNES += "cortexa57_32 cortexa57_32t cortexa57_32-crypto cortexa57_32t-crypto"
ARMPKGARCH_tune-cortexa57_32         ?= "cortexa57"
ARMPKGARCH_tune-cortexa57_32t        ?= "cortexa57"
ARMPKGARCH_tune-cortexa57_32-crypto  ?= "cortexa57"
ARMPKGARCH_tune-cortexa57_32t-crypto ?= "cortexa57"
TUNE_FEATURES_tune-cortexa57_32         = "${TUNE_FEATURES_tune-aarch32}         cortexa57"
TUNE_FEATURES_tune-cortexa57_32t        = "${TUNE_FEATURES_tune-aarch32t}        cortexa57"
TUNE_FEATURES_tune-cortexa57_32-crypto  = "${TUNE_FEATURES_tune-aarch32-crypto}  cortexa57"
TUNE_FEATURES_tune-cortexa57_32t-crypto = "${TUNE_FEATURES_tune-aarch32t-crypto} cortexa57"
PACKAGE_EXTRA_ARCHS_tune-cortexa57_32         = "${PACKAGE_EXTRA_ARCHS_tune-aarch32} cortexa57hf-neon-fp-armv8"
PACKAGE_EXTRA_ARCHS_tune-cortexa57_32t        = "${PACKAGE_EXTRA_ARCHS_tune-cortexa57_32} cortexa57t2hf-neon-fp-armv8"
PACKAGE_EXTRA_ARCHS_tune-cortexa57_32-crypto  = "${PACKAGE_EXTRA_ARCHS_tune-cortexa57_32} cortexa57hf-crypto-neon-fp-armv8"
PACKAGE_EXTRA_ARCHS_tune-cortexa57_32t-crypto = "${PACKAGE_EXTRA_ARCHS_tune-cortexa57_32-crypto} cortexa57t2hf-crypto-neon-fp-armv8"

# AArch32 Big Endian base configs
AVAILTUNES += "cortexa57_32b cortexa57_32tb cortexa57_32b-crypto cortexa57_32tb-crypto"
ARMPKGARCH_tune-cortexa57_32b         ?= "cortexa57"
ARMPKGARCH_tune-cortexa57_32tb        ?= "cortexa57"
ARMPKGARCH_tune-cortexa57_32b-crypto  ?= "cortexa57"
ARMPKGARCH_tune-cortexa57_32tb-crypto ?= "cortexa57"
TUNE_FEATURES_tune-cortexa57_32b         = "${TUNE_FEATURES_tune-aarch32b}         cortexa57"
TUNE_FEATURES_tune-cortexa57_32tb        = "${TUNE_FEATURES_tune-aarch32tb}        cortexa57"
TUNE_FEATURES_tune-cortexa57_32b-crypto  = "${TUNE_FEATURES_tune-aarch32b-crypto}  cortexa57"
TUNE_FEATURES_tune-cortexa57_32tb-crypto = "${TUNE_FEATURES_tune-aarch32tb-crypto} cortexa57"
PACKAGE_EXTRA_ARCHS_tune-cortexa57_32b         = "${PACKAGE_EXTRA_ARCHS_tune-aarch32b} cortexa57hfb-neon-fp-armv8"
PACKAGE_EXTRA_ARCHS_tune-cortexa57_32tb        = "${PACKAGE_EXTRA_ARCHS_tune-cortexa57_32b} cortexa57t2hfb-neon-fp-armv8"
PACKAGE_EXTRA_ARCHS_tune-cortexa57_32b-crypto  = "${PACKAGE_EXTRA_ARCHS_tune-cortexa57_32b} cortexa57hfb-crypto-neon-fp-armv8"
PACKAGE_EXTRA_ARCHS_tune-cortexa57_32tb-crypto = "${PACKAGE_EXTRA_ARCHS_tune-cortexa57_32b-crypto} cortexa57t2hfb-crypto-neon-fp-armv8"
```

## meta-intel-axxia/conf/bblayers.conf.sample
```bitbake
# LAYER_CONF_VERSION is increased each time build/conf/bblayers.conf
# changes incompatibly
LCONF_VERSION = "6"

BBPATH = "${TOPDIR}"
BBFILES ?= ""

BBLAYERS ?= " \
  ##OEROOT##/meta \
  ##OEROOT##/meta-poky \
  ##OEROOT##/../meta-openembedded/meta-oe \
  ##OEROOT##/../meta-openembedded/meta-networking \
  ##OEROOT##/../meta-openembedded/meta-filesystems \
  ##OEROOT##/../meta-openembedded/meta-python \
  ##OEROOT##/../meta-openembedded/meta-perl \
  ##OEROOT##/../meta-security \
  ##OEROOT##/../meta-security/meta-tpm \
  ##OEROOT##/../meta-ros \
  ##OEROOT##/../meta-virtualization \
  ##OEROOT##/../meta-intel \
  ##OEROOT##/../meta-intel-axxia/meta-intel-axxia \
  ##OEROOT##/../meta-intel-axxia/meta-intel-snr \
  "
```

## meta-intel-axxia/conf/distro/include/intel-axxia-custom.inc
```bitbake
# Set alternative kernels (different from virtual/kenrel provider)
ALTERNATIVE_KERNELS ?= "\
${@oe.utils.conditional('PREFERRED_PROVIDER_virtual/kernel',\
	'linux-intel', '',          ' linux-intel', d)}\
${@oe.utils.conditional('PREFERRED_PROVIDER_virtual/kernel',\
	'linux-intel-rt', '',       ' linux-intel-rt', d)}\
${@oe.utils.conditional('PREFERRED_PROVIDER_virtual/kernel',\
	'linux-intel-debug', '',    ' linux-intel-debug', d)}\
${@oe.utils.conditional('PREFERRED_PROVIDER_virtual/kernel',\
	'linux-intel-rt-debug', '', ' linux-intel-rt-debug', d)}\
"
ALTERNATIVE_KERNELS_INSTALL ?= \
"${@d.getVar('ALTERNATIVE_KERNELS').replace('linux-','kernel-linux-')}"

ALTERNATIVE_KERNELS_MODULES_INSTALL ?= \
"${@'-modules '.join(d.getVar('ALTERNATIVE_KERNELS_INSTALL')[1:].split(' '))}-modules"

ALTERNATIVE_KERNELS_LTTNG_MODULES ?= \
"${@d.getVar('ALTERNATIVE_KERNELS').replace('linux-','lttng-modules-linux-')}"

ALTERNATIVE_KERNELS_CLEAN_TASK = \
"${@':do_clean '.join(d.getVar('ALTERNATIVE_KERNELS')[1:].split(' '))}:do_clean"
ALTERNATIVE_KERNELS_CLEANSSTATE_TASK = \
"${@':do_cleansstate '.join(d.getVar('ALTERNATIVE_KERNELS')[1:].split(' '))}:do_cleansstate"
ALTERNATIVE_KERNELS_CLEAN = \
"${@oe.utils.conditional('ALTERNATIVE_KERNELS', '', '', '${ALTERNATIVE_KERNELS_CLEAN_TASK}', d)}"
ALTERNATIVE_KERNELS_CLEANSSTATE = \
"${@oe.utils.conditional('ALTERNATIVE_KERNELS', '', '', '${ALTERNATIVE_KERNELS_CLEANSSTATE_TASK}', d)}"

# Fix multilib install file conflicts
ALTERNATIVE_PRIORITY_libtool = "20"
ALTERNATIVE_PRIORITY_lib32-libtool = "10"

ALTERNATIVE_PRIORITY_icu-dev = "20"
ALTERNATIVE_PRIORITY_lib32-icu-dev = "10"

ALTERNATIVE_PRIORITY_gobject-introspection = "20"
ALTERNATIVE_PRIORITY_lib32-gobject-introspection = "10"

ALTERNATIVE_PRIORITY_python3-dev = "90"
ALTERNATIVE_PRIORITY_lib32-python3-dev = "80"

ALTERNATIVE_PRIORITY_libgpg-error-dev = "20"
ALTERNATIVE_PRIORITY_lib32-libgpg-error-dev = "10"
```

## meta-intel-axxia/conf/distro/include/intel-axxia-defaults.inc
```bitbake
PREFERRED_RPROVIDER_iasl ?= "iasl"
PREFERRED_RPROVIDER_iasl-native ?= "iasl-native"

PREFERRED_VERSION_autofs ?= "5.1.5"

PREFERRED_VERSION_rpcbind ?= "0.2.3"

PREFERRED_VERSION_mcelog ?= "164"

PREFERRED_VERSION_thrift ?= "0.11.0"
PREFERRED_VERSION_thrift-native ?= "0.11.0"

PREFERRED_VERSION_boost ?= "1.70.0"
PREFERRED_VERSION_boost-native ?= "1.70.0"
PREFERRED_VERSION_bjam-native ?= "1.70.0"

GCC_VERSION = "${@bb.utils.contains('DISTRO_FEATURES', 'gcc9', '9%', '8%', d)}"
PREFERRED_VERSION_gcc ?= "${GCC_VERSION}"
PREFERRED_VERSION_gcc-runtime ?= "${GCC_VERSION}"
PREFERRED_VERSION_gcc-sanitizers ?= "${GCC_VERSION}"
PREFERRED_VERSION_gcc-source ?= "${GCC_VERSION}"
PREFERRED_VERSION_gcc-runtime ?= "${GCC_VERSION}"
PREFERRED_VERSION_gcc-cross-${TARGET_ARCH} ?= "${GCC_VERSION}"
PREFERRED_VERSION_gcc-crosssdk-${SDK_SYS} ?= "${GCC_VERSION}"
PREFERRED_VERSION_gcc-cross-canadian-${TRANSLATED_TARGET_ARCH} ?= "${GCC_VERSION}"
PREFERRED_VERSION_libgcc ?= "${GCC_VERSION}"
PREFERRED_VERSION_libgcc-initial ?= "${GCC_VERSION}"
PREFERRED_VERSION_libgfortran ?= "${GCC_VERSION}"
PREFERRED_VERSION_nativesdk-gcc ?= "${GCC_VERSION}"
PREFERRED_VERSION_nativesdk-gcc-runtime ?= "${GCC_VERSION}"
PREFERRED_VERSION_nativesdk-gcc-sanitizers ?= "${GCC_VERSION}"
PREFERRED_VERSION_nativesdk-gcc-source ?= "${GCC_VERSION}"
PREFERRED_VERSION_nativesdk-gcc-runtime ?= "${GCC_VERSION}"
PREFERRED_VERSION_nativesdk-gcc-cross-${TARGET_ARCH} ?= "${GCC_VERSION}"
PREFERRED_VERSION_nativesdk-gcc-crosssdk-${SDK_SYS} ?= "${GCC_VERSION}"
PREFERRED_VERSION_nativesdk-gcc-cross-canadian-${TRANSLATED_TARGET_ARCH} ?= "${GCC_VERSION}"
PREFERRED_VERSION_nativesdk-libgcc ?= "${GCC_VERSION}"
PREFERRED_VERSION_nativesdk-libgcc-initial ?= "${GCC_VERSION}"
PREFERRED_VERSION_nativesdk-libgfortran ?= "${GCC_VERSION}"

GLIBC_VERSION = "${@bb.utils.contains('DISTRO_FEATURES', 'gcc9', '2.29', '2.28', d)}"
PREFERRED_VERSION_glibc ?= "${GLIBC_VERSION}"
PREFERRED_VERSION_glibc-scripts ?= "${GLIBC_VERSION}"
PREFERRED_VERSION_glibc-mtrace ?= "${GLIBC_VERSION}"
PREFERRED_VERSION_glibc-locale ?= "${GLIBC_VERSION}"
PREFERRED_VERSION_cross-localedef-native ?= "${GLIBC_VERSION}"
PREFERRED_VERSION_nativesdk-glibc ?= "${GLIBC_VERSION}"
PREFERRED_VERSION_nativesdk-glibc-scripts ?= "${GLIBC_VERSION}"
PREFERRED_VERSION_nativesdk-glibc-mtrace ?= "${GLIBC_VERSION}"
PREFERRED_VERSION_nativesdk-glibc-locale ?= "${GLIBC_VERSION}"
PREFERRED_VERSION_nativesdk-cross-localedef-native ?= "${GLIBC_VERSION}"

PREFERRED_VERSION_libxcrypt ?= "${@bb.utils.contains('DISTRO_FEATURES', 'gcc9','4.4%', '4.1%', d)}"
```
