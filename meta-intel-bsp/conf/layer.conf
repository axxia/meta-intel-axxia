## meta-intel-distro/conf/distro/include/intel-axxia-custom.inc
```bitbake
# Set default alternative kernel to the debug variant of the current kernel provider.
# linux-local and linux-korg have no debug variant.
ALTERNATIVE_KERNELS ?= "${@'' if d.getVar('PREFERRED_PROVIDER_virtual/kernel') in \
    ['linux-local', 'linux-korg'] else \
    ' ' + d.getVar('PREFERRED_PROVIDER_virtual/kernel') + '-debug'}"

ALTERNATIVE_KERNELS_INSTALL ?= \
"${@d.getVar('ALTERNATIVE_KERNELS').replace('linux-','altkernel-linux-')}"

ALTERNATIVE_KERNELS_MODULES_INSTALL ?= \
"${@'-modules '.join(d.getVar('ALTERNATIVE_KERNELS_INSTALL').split())}-modules"

ALTERNATIVE_KERNELS_LTTNG_MODULES ?= \
"${@' '.join('lttng-modules-' + k for k in d.getVar('ALTERNATIVE_KERNELS').split())}"

ALTERNATIVE_KERNELS_BOOT_LABELS = \
"${@d.getVar('ALTERNATIVE_KERNELS').replace('linux-','boot-linux-')}"

ALTERNATIVE_KERNELS_CLEAN_TASK = \
"${@':do_clean '.join(d.getVar('ALTERNATIVE_KERNELS').split())}:do_clean"
ALTERNATIVE_KERNELS_CLEANSSTATE_TASK = \
"${@':do_cleansstate '.join(d.getVar('ALTERNATIVE_KERNELS').split())}:do_cleansstate"
ALTERNATIVE_KERNELS_DEPLOY_TASK = \
"${@':do_deploy '.join(d.getVar('ALTERNATIVE_KERNELS').split())}:do_deploy"
ALTERNATIVE_KERNELS_CLEAN = \
"${@oe.utils.conditional('ALTERNATIVE_KERNELS', '', '', '${ALTERNATIVE_KERNELS_CLEAN_TASK}', d)}"
ALTERNATIVE_KERNELS_CLEANSSTATE = \
"${@oe.utils.conditional('ALTERNATIVE_KERNELS', '', '', '${ALTERNATIVE_KERNELS_CLEANSSTATE_TASK}', d)}"
ALTERNATIVE_KERNELS_DEPLOY = \
"${@oe.utils.conditional('ALTERNATIVE_KERNELS', '', '', '${ALTERNATIVE_KERNELS_DEPLOY_TASK}', d)}"
```

## meta-intel-distro/conf/distro/include/intel-axxia-defaults.inc
```bitbake
# Set the version for the debug variant of the current kernel provider
python __anonymous() {
    provider = d.getVar('PREFERRED_PROVIDER_virtual/kernel')
    kv = d.getVar('PREFERRED_VERSION_' + provider)
    if kv and not provider.endswith('-debug'):
        d.setVar('PREFERRED_VERSION_' + provider + '-debug', kv)
}

ETHTOOL_VERSION ?= "6.19"
PREFERRED_VERSION_ethtool ?= "${ETHTOOL_VERSION}%"

IPROUTE2_VERSION ?= "6.19"
PREFERRED_VERSION_iproute2 ?= "${IPROUTE2_VERSION}%"

# Avoid warnings for recipes with dynamic version
PREFERRED_VERSION_linux-intel-private ??= "dev%"
PREFERRED_VERSION_linux-intel-private-debug ??= "dev%"
PREFERRED_VERSION_linux-intel-collab ??= "%"
PREFERRED_VERSION_linux-intel-collab-debug ??= "%"
PREFERRED_VERSION_linux-korg-netnext ??= "%"
PREFERRED_VERSION_linux-korg-netnext-debug ??= "%"

PREFERRED_VERSION_libxcrypt-compat ?= "4.1.1"

PREFERRED_VERSION_linux-firmware ?= "20210511"

PREFERRED_RPROVIDER_libnss-mdns = "avahi-libnss-mdns"

VIRTUAL-RUNTIME_syslog ?= "rsyslog"

FORTRAN:forcevariable = ",fortran"
```

## meta-intel-distro/conf/distro/intel-axxia.conf
```bitbake
require conf/distro/poky.conf \
	${@bb.utils.contains('DISTRO_FEATURES', 'multilib', \
	'conf/multilib.conf', '', d)} \
	${@bb.utils.contains('DISTRO_FEATURES', 'qsp', \
	'conf/distro/include/intel-axxia-qsp.inc', '', d)}

DISTRO = "intel-axxia"
DISTRO_NAME = "Intel Axxia Distro"
DISTRO_VERSION = "${RELEASE_VERSION}"
DISTRO_CODENAME = "intel-axxia"
SDK_VENDOR = "-intelaxxiasdk"
SDK_VERSION := "${RELEASE_VERSION}"

TARGET_VENDOR = "-intelaxxia"
RELEASE_VERSION ??= "default"

DISTRO_FEATURES:append = " pam virtualization kvm security tpm"

include conf/distro/include/intel-axxia-defaults.inc
include conf/distro/include/intel-axxia-custom.inc
include conf/distro/include/intel-axxia-flags.inc

CLANGSDK = "1"

BBMASK:append = " ${@bb.utils.contains('DISTRO_FEATURES', 'simics', '', \
			'meta-intel-distro/recipes-support/simics', d)} \
		  ${@oe.utils.conditional('ALTERNATIVE_KERNELS', '', \
			'meta-intel-distro/recipes-kernel/lttng/lttng-modules-alternative*', '', d)} \
		  "
```
