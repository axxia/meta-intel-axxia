## meta-intel-distro/conf/distro/include/intel-axxia-gcc11.inc
```bitbake
# GCC11 doesn't recognized '-fcanon-prefix-map' option from DEBUG_PREFIX_MAP
DEBUG_PREFIX_MAP = "-fmacro-prefix-map=${WORKDIR}=/usr/src/debug/${PN}/${EXTENDPE}${PV}-${PR} \
                     -fdebug-prefix-map=${WORKDIR}=/usr/src/debug/${PN}/${EXTENDPE}${PV}-${PR} \
                     -fdebug-prefix-map=${STAGING_DIR_HOST}= \
                     -fdebug-prefix-map=${STAGING_DIR_NATIVE}= \
"
```

## meta-intel-distro/conf/distro/include/intel-axxia-qsp.inc
```bitbake
INHERIT += "archiver"
ARCHIVER_MODE[src] = "original"

COPY_LIC_MANIFEST = "1"
COPY_LIC_DIRS = "1"

# Use busybox ip since ip.iproute2 has wrong interpreter
RDEPENDS:iproute2:remove = "iproute2-ip"
```

## meta-intel-distro/conf/layer.conf
```bitbake
# We have a conf and classes directory, add to BBPATH
BBPATH .= ":${LAYERDIR}"

# We have recipes-* directories, add to BBFILES
BBFILES += "${LAYERDIR}/recipes-*/*/*.bb \
	${LAYERDIR}/recipes-*/*/*.bbappend \
	${LAYERDIR}/../common/recipes-*/*/*.bb \
	${LAYERDIR}/../common/recipes-*/*/*.bbappend"

BBFILE_COLLECTIONS += "intel-distro"
BBFILE_PATTERN_intel-distro := "^${LAYERDIR}/"
BBFILE_PRIORITY_intel-distro = "5"

LAYERSERIES_COMPAT_intel-distro = "kirkstone"
LAYERDEPENDS_intel-distro = " \
	core \
	yocto \
	openembedded-layer \
	networking-layer \
	filesystems-layer \
	meta-python \
	perl-layer \
	security \
	tpm-layer \
	virtualization-layer \
	intel \
	intel-bsp \
"

# We have a pre-populated downloads directory, add to PREMIRRORS
PREMIRRORS:prepend := "\
     file://.*/.* file://${LAYERDIR}/downloads/ \n \
     git://.*/.* git:///${LAYERDIR}/downloads/MIRRORNAME;protocol=file \n \
     git://.*/.* file://${LAYERDIR}/downloads/ \n \
     svn://.*/.* file://${LAYERDIR}/downloads/ \n \
     ftp://.*/.* file://${LAYERDIR}/downloads/ \n \
     http://.*/.* file://${LAYERDIR}/downloads/ \n \
     https://.*/.* file://${LAYERDIR}/downloads/ \n"
```

## meta-intel-distro/conf/local.conf.sample
```bitbake
# Intel Axxia hardware board target machine: intel-axxia-snr or intel-axxia-grr
MACHINE = "intel-axxia-grr"

# Kernel providers: linux-intel, linux-intel-rt, linux-intel-debug, linux-intel-rt-debug
PREFERRED_PROVIDER_virtual/kernel = "linux-intel"

# Kernel versions: 5.15 (default) or 5.10
PREFERRED_VERSION_linux-intel = "5.15%"

# Add simics support (sources should be in meta-intel-distro/download)
# and set simics version to compile (mandatory).
#DISTRO_FEATURES:append = " simics"
#SIMICS_VERSION = ""

# Enable "multilib"
#DISTRO_FEATURES:append = " multilib"

# Choose GCC version: 13.% (gcc13). Default version: 11.%
#DISTRO_FEATURES:append = " gcc13"

# Enable settings for INTEL QSP System (for axxia-image-qsp image)
#DISTRO_FEATURES:append = " qsp"

# Release version should be the meta-intel-axxia repository tag from release note.
# RELEASE_VERSION = "" 

BB_NUMBER_THREADS ?= "${@oe.utils.cpu_count()}"
PARALLEL_MAKE ?= "-j ${@oe.utils.cpu_count()}"

# Assume directories were created under TOPDIR
#DL_DIR ?= "${TOPDIR}/downloads"
#SSTATE_DIR ?= "${TOPDIR}/sstate-cache"
#TMPDIR = "${TOPDIR}/tmp"

DISTRO = "intel-axxia"
PACKAGE_CLASSES ?= "package_rpm"
EXTRA_IMAGE_FEATURES ?= "debug-tweaks"
USER_CLASSES ?= "buildstats"
PATCHRESOLVE = "noop"
BB_DISKMON_DIRS ??= "\
    STOPTASKS,${TMPDIR},1G,100K \
    STOPTASKS,${DL_DIR},1G,100K \
    STOPTASKS,${SSTATE_DIR},1G,100K \
    STOPTASKS,/tmp,100M,100K \
    HALT,${TMPDIR},100M,1K \
    HALT,${DL_DIR},100M,1K \
    HALT,${SSTATE_DIR},100M,1K \
    HALT,/tmp,10M,1K"
PACKAGECONFIG:append:pn-qemu-system-native = " sdl"
CONF_VERSION = "2"

# For more options check meta-intel-distro layer for README and 
# conf/local.conf.sample.extended
```

## meta-intel-rdk/conf/distro/intel-axxia-indist.conf
```bitbake
require conf/distro/intel-axxia.conf

DISTRO = "intel-axxia-indist"
DISTRO_NAME = "Intel Axxia In-Distribution Distro"
DISTRO_CODENAME = "intel-axxia-indist"

# Variables for each RDK source code archive
RDK_KLM_ARCHIVE ?= "file://rdk_klm_src.tar.xz"
RDK_TOOLS_ARCHIVE ?= "file://rdk_user_src.tar.xz"

# Autoload RDK kernels (disabled from blacklist.conf)
#KERNEL_MODULE_AUTOLOAD_append_axxiax86-64 = " hqm"
#KERNEL_MODULE_AUTOLOAD_append_axxiax86-64 = " igb"
#KERNEL_MODULE_AUTOLOAD_append_axxiax86-64 = " qat_c4xxx"
#KERNEL_MODULE_AUTOLOAD_append_axxiax86-64 = " intel_qat"
#KERNEL_MODULE_AUTOLOAD_append_axxiax86-64 = " ice_sw"

# Enable RDK userspace support
#DISTRO_FEATURES_append = " rdk-userspace"

BBMASK_append = "${@bb.utils.contains('DISTRO_FEATURES', 'rdk-userspace', \
				      '', ' rdk-tools*', d)}"
```

## meta-intel-rdk/conf/layer.conf
```bitbake
# We have a conf and classes directory, add to BBPATH
BBPATH .= ":${LAYERDIR}"

# We have recipes-* directories, add to BBFILES
BBFILES += "${LAYERDIR}/recipes-*/*/*.bb \
	${LAYERDIR}/recipes-*/*/*.bbappend"

BBFILE_COLLECTIONS += "intel-rdk"
BBFILE_PATTERN_intel-rdk = "^${LAYERDIR}/"
BBFILE_PRIORITY_intel-rdk = "6"

LAYERSERIES_COMPAT_intel-rdk = "kirkstone"
LAYERDEPENDS_intel-rdk = "intel-bsp openembedded-layer"

RDK_LAYER_PATH = "${LAYERDIR}" 

require conf/distro/include/rdk-defaults.inc
```

## meta-intel-snr/conf/layer.conf
```bitbake
# We have a conf and classes directory, add to BBPATH
BBPATH .= ":${LAYERDIR}"

# We have recipes-* directories, add to BBFILES
BBFILES += "${LAYERDIR}/recipes-*/*/*.bb \
	${LAYERDIR}/recipes-*/*/*.bbappend"

BBFILE_COLLECTIONS += "intel-snr"
BBFILE_PATTERN_intel-snr := "^${LAYERDIR}/"
BBFILE_PRIORITY_intel-snr = "5"

LAYERSERIES_COMPAT_intel-snr = "thud"
LAYERDEPENDS_intel-snr = "intel"
```

## meta-intel-snr/conf/machine/axxiax86-64.conf
```bitbake
#@TYPE: Machine
#@NAME: axxiax86-64
#@DESCRIPTION: Machine configuration for INTEL Axxia x86_64 systems (Intel Snowridge CPU) with MMX, SSE, SSE2, SSE3, SSSE3, SSE4.1 and SSE4.2 instruction set support. Supports a moderately wide range of drivers that should boot and be usable on "typical" hardware.

PREFERRED_PROVIDER_virtual/kernel ?= "linux-intel"
PREFERRED_VERSION_linux-intel ?= "5.10%"
PREFERRED_VERSION_linux-intel-rt ?= "5.10%"

require conf/machine/include/meta-intel.inc
require conf/machine/include/tune-snr.inc
require conf/machine/include/intel-common-pkgarch.inc

MACHINE_FEATURES += "pcbios efi"
MACHINE_FEATURES += "intel-ucode ext3"

KARCH = "x86_64"
KERNEL_IMAGETYPE = "bzImage"
KEEPUIMAGE = "no"

EFI_PROVIDER ?= "grub-efi"

SYSLINUX_OPTS = "serial 0 115200"
SERIAL_CONSOLES = "115200;ttyS0 115200;ttyS4"
SERIAL_CONSOLES_CHECK = "${SERIAL_CONSOLES}"

APPEND = "console=tty0 console=ttyS0,115200 reboot=p,w intel_iommu=on idle=poll"

DEFAULTTUNE_virtclass-multilib-lib32 = "snr-32"
MULTILIBS = "multilib:lib32"

IMAGE_FSTYPES += " ext2"
IMAGE_FSTYPES += " tar.gz"
IMAGE_FSTYPES += " iso"
NOISO = "0"

IMAGE_FSTYPES += "wic"
WKS_FILE = "${@bb.utils.contains_any("EFI_PROVIDER", "systemd-boot", \
	   "axxia-systemd-bootdisk-microcode.wks", \
	   "axxia-grub-bootdisk-microcode.wks", d)}"
WKS_FILE_DEPENDS_append = " intel-microcode"

# QEMU usermode fails with invalid instruction error
MACHINE_FEATURES_BACKFILL_CONSIDERED_append = " qemu-usermode"
# Disable 'update_gio_module_cache 'and 'update_font_cache' postinstall
# intercept hooks because of missing qemu usermode support
GIO_MODULE_PACKAGES_forcevariable = ""
FONT_PACKAGES_forcevariable = ""
```

## meta-intel-snr/conf/machine/include/tune-core2snr.inc
```bitbake
# Settings for Intel Snowridge CPU with 64-bit extensions, MMX, SSE, SSE2,
# SSE3, SSSE3, SSE4.1 and SSE4.2 instruction set support.
#
# This tune is recommended for the new Intel Core 2 CPU, including Snowridge,
# and beyond.
#

DEFAULTTUNE ?= "core2snr-64"

# Include the previous tune to pull in PACKAGE_EXTRA_ARCHS
require conf/machine/include/tune-core2.inc

# Extra tune features
TUNEVALID[core2snr] = "Enable core2snr specific processor optimizations"
TUNE_CCARGS .= "${@bb.utils.contains('TUNE_FEATURES', 'core2snr', ' -march=core2 -mtune=core2 -mfpmath=sse -msse4.2', '', d)}"

# Extra tune selections
AVAILTUNES += "core2snr-32"
TUNE_FEATURES_tune-core2snr-32 = "${TUNE_FEATURES_tune-x86} core2snr"
BASE_LIB_tune-core2snr-32 = "lib"
TUNE_PKGARCH_tune-core2snr-32 = "core2snr-32"
PACKAGE_EXTRA_ARCHS_tune-core2snr-32 = "${PACKAGE_EXTRA_ARCHS_tune-core2-32} core2snr-32"
QEMU_EXTRAOPTIONS_core2snr-32 = " -cpu n270"

AVAILTUNES += "core2snr-64"
TUNE_FEATURES_tune-core2snr-64 = "${TUNE_FEATURES_tune-x86-64} core2snr"
BASE_LIB_tune-core2snr-64 = "lib64"
TUNE_PKGARCH_tune-core2snr-64 = "core2snr-64"
PACKAGE_EXTRA_ARCHS_tune-core2snr-64 = "${PACKAGE_EXTRA_ARCHS_tune-core2-64} core2snr-64"
QEMU_EXTRAOPTIONS_core2snr-64 = " -cpu core2duo"

AVAILTUNES += "core2snr-64-x32"
TUNE_FEATURES_tune-core2snr-64-x32 = "${TUNE_FEATURES_tune-x86-64-x32} core2snr"
BASE_LIB_tune-core2snr-64-x32 = "libx32"
TUNE_PKGARCH_tune-core2snr-64-x32 = "core2snr-64-x32"
PACKAGE_EXTRA_ARCHS_tune-core2snr-64-x32 = "${PACKAGE_EXTRA_ARCHS_tune-core2-64-x32} core2snr-64-x32"
QEMU_EXTRAOPTIONS_core2snr-64-x32 = " -cpu core2duo"
```

## meta-intel-snr/conf/machine/include/tune-snr.inc
```bitbake
# Settings for Intel Snowridge CPU with 64-bit extensions, MMX, SSE, SSE2,
# SSE3, SSSE3, SSE4.1 and SSE4.2 instruction set support.
#
# This tune is recommended for the new Intel Snowridge CPU and beyond.
#

DEFAULTTUNE ?= "snr-64"

# Include the previous tune to pull in PACKAGE_EXTRA_ARCHS
require conf/machine/include/tune-core2.inc

# Extra tune features
TUNEVALID[snr] = "Enable snr specific processor optimizations"
CPU_MATCH = "${@bb.utils.contains('DISTRO_FEATURES', 'gcc8', 'core2', 'tremont', d)}"
TUNE_CCARGS .= "${@bb.utils.contains('TUNE_FEATURES', 'snr', ' -march=${CPU_MATCH} -mtune=${CPU_MATCH} -mfpmath=sse -msse4.2', '', d)}"

# Extra tune selections
AVAILTUNES += "snr-32"
TUNE_FEATURES_tune-snr-32 = "${TUNE_FEATURES_tune-x86} snr"
BASE_LIB_tune-snr-32 = "lib"
TUNE_PKGARCH_tune-snr-32 = "snr-32"
PACKAGE_EXTRA_ARCHS_tune-snr-32 = "${PACKAGE_EXTRA_ARCHS_tune-core2-32} snr-32"
QEMU_EXTRAOPTIONS_snr-32 = " -cpu ${@bb.utils.contains('DISTRO_FEATURES', 'gcc8', 'n270', 'tremont', d)},check=false"

AVAILTUNES += "snr-64"
TUNE_FEATURES_tune-snr-64 = "${TUNE_FEATURES_tune-x86-64} snr"
BASE_LIB_tune-snr-64 = "lib64"
TUNE_PKGARCH_tune-snr-64 = "snr-64"
PACKAGE_EXTRA_ARCHS_tune-snr-64 = "${PACKAGE_EXTRA_ARCHS_tune-core2-64} snr-64"
QEMU_EXTRAOPTIONS_snr-64 = " -cpu ${@bb.utils.contains('DISTRO_FEATURES', 'gcc8', 'core2duo', 'tremont', d)},check=false"

AVAILTUNES += "snr-64-x32"
TUNE_FEATURES_tune-snr-64-x32 = "${TUNE_FEATURES_tune-x86-64-x32} snr"
BASE_LIB_tune-snr-64-x32 = "libx32"
TUNE_PKGARCH_tune-snr-64-x32 = "snr-64-x32"
PACKAGE_EXTRA_ARCHS_tune-snr-64-x32 = "${PACKAGE_EXTRA_ARCHS_tune-core2-64-x32} snr-64-x32"
QEMU_EXTRAOPTIONS_snr-64-x32 = " -cpu ${@bb.utils.contains('DISTRO_FEATURES', 'gcc8', 'core2duo', 'tremont', d)},check=false"
```

## meta-intel-vcn/conf/distro/include/intel-axxia-custom.inc
```bitbake
# Set alternative kernels (different from virtual/kernel provider)
INTEL_ALTERNATIVE_KERNELS ?= "\
${@oe.utils.conditional('PREFERRED_PROVIDER_virtual/kernel',\
	'linux-intel', '',          ' linux-intel', d)}\
${@oe.utils.conditional('PREFERRED_PROVIDER_virtual/kernel',\
	'linux-intel-rt', '',       ' linux-intel-rt', d)}\
${@oe.utils.conditional('PREFERRED_PROVIDER_virtual/kernel',\
	'linux-intel-debug', '',    ' linux-intel-debug', d)}\
${@oe.utils.conditional('PREFERRED_PROVIDER_virtual/kernel',\
	'linux-intel-rt-debug', '', ' linux-intel-rt-debug', d)}\
"

YOCTO_ALTERNATIVE_KERNELS ?= "\
${@oe.utils.conditional('PREFERRED_PROVIDER_virtual/kernel',\
	'linux-yocto', '',          ' linux-yocto', d)}\
${@oe.utils.conditional('PREFERRED_PROVIDER_virtual/kernel',\
	'linux-yocto-rt', '',       ' linux-yocto-rt', d)}\
${@oe.utils.conditional('PREFERRED_PROVIDER_virtual/kernel',\
	'linux-yocto-debug', '',    ' linux-yocto-debug', d)}\
${@oe.utils.conditional('PREFERRED_PROVIDER_virtual/kernel',\
	'linux-yocto-rt-debug', '', ' linux-yocto-rt-debug', d)}\
"

ALTERNATIVE_KERNELS ?= \
"${${@''.join(d.getVar('PREFERRED_PROVIDER_virtual/kernel').upper()\
	.split('-')[1:2])}_ALTERNATIVE_KERNELS}"

ALTERNATIVE_KERNELS_INSTALL ?= \
"${@d.getVar('ALTERNATIVE_KERNELS').replace('linux-','kernel-linux-')}"

ALTERNATIVE_KERNELS_MODULES_INSTALL ?= \
"${@'-modules '.join(d.getVar('ALTERNATIVE_KERNELS_INSTALL')[1:].split(' '))}-modules"

ALTERNATIVE_KERNELS_LTTNG_MODULES ?= \
"${@d.getVar('ALTERNATIVE_KERNELS').replace('linux-','lttng-modules-linux-')}"

ALTERNATIVE_KERNELS_CLEAN_TASK = \
"${@':do_clean '.join(d.getVar('ALTERNATIVE_KERNELS')[1:].split(' '))}:do_clean"
ALTERNATIVE_KERNELS_CLEANSSTATE_TASK = \
"${@':do_cleansstate '.join(d.getVar('ALTERNATIVE_KERNELS')[1:].split(' '))}:do_cleansstate"
ALTERNATIVE_KERNELS_CLEAN = \
"${@oe.utils.conditional('ALTERNATIVE_KERNELS', '', '', '${ALTERNATIVE_KERNELS_CLEAN_TASK}', d)}"
ALTERNATIVE_KERNELS_CLEANSSTATE = \
"${@oe.utils.conditional('ALTERNATIVE_KERNELS', '', '', '${ALTERNATIVE_KERNELS_CLEANSSTATE_TASK}', d)}"

# Fix multilib install file conflicts
ALTERNATIVE_PRIORITY_libtool = "20"
ALTERNATIVE_PRIORITY_lib32-libtool = "10"

ALTERNATIVE_PRIORITY_icu-dev = "20"
ALTERNATIVE_PRIORITY_lib32-icu-dev = "10"

ALTERNATIVE_PRIORITY_gobject-introspection = "20"
ALTERNATIVE_PRIORITY_lib32-gobject-introspection = "10"

ALTERNATIVE_PRIORITY_python3-dev = "90"
ALTERNATIVE_PRIORITY_lib32-python3-dev = "80"

ALTERNATIVE_PRIORITY_libgpg-error-dev = "20"
ALTERNATIVE_PRIORITY_lib32-libgpg-error-dev = "10"
```

## meta-intel-vcn/conf/distro/include/intel-axxia-defaults.inc
```bitbake
PREFERRED_VERSION_linux-intel-debug ?= "5.10%"
PREFERRED_VERSION_linux-intel-rt-debug ?= "5.10%"

PREFERRED_VERSION_linux-yocto ?= "5.10%"
PREFERRED_VERSION_linux-yocto-rt ?= "5.10%"
PREFERRED_VERSION_linux-yocto-debug ?= "5.10%"
PREFERRED_VERSION_linux-yocto-rt-debug ?= "5.10%"

PREFERRED_VERSION_thrift ?= "0.11.0"
PREFERRED_VERSION_thrift-native ?= "0.11.0"

PREFERRED_VERSION_boost ?= "1.70.0"
PREFERRED_VERSION_boost-native ?= "1.70.0"
PREFERRED_VERSION_bjam-native ?= "1.70.0"

PYTHON_VERSION ?= "3.9"
PYTHON_BASEVERSION_forcevariable = "${PYTHON_VERSION}"
PYTHON_ABI_forcevariable = "${@oe.utils.conditional('PYTHON_VERSION', '3.6', 'm', '', d)}"
PREFERRED_VERSION_python3 ?= "${PYTHON_VERSION}%"
PREFERRED_VERSION_python3-native ?= "${PYTHON_VERSION}%"
PREFERRED_VERSION_nativesdk-python3 ?= "${PYTHON_VERSION}%"
PREFERRED_VERSION_gpgme = "${@oe.utils.conditional('PYTHON_VERSION', '3.6', '1.12%', '1.15%', d)}"
PREFERRED_VERSION_gpgme-native = "${PREFERRED_VERSION_gpgme}"
```

## meta-intel-vcn/conf/layer.conf
```bitbake
# We have a conf and classes directory, add to BBPATH
BBPATH .= ":${LAYERDIR}"

# We have recipes-* directories, add to BBFILES
BBFILES += "${LAYERDIR}/recipes-*/*/*.bb \
	${LAYERDIR}/recipes-*/*/*.bbappend"

BBFILE_COLLECTIONS += "intel-vcn"
BBFILE_PATTERN_intel-vcn := "^${LAYERDIR}/"
BBFILE_PRIORITY_intel-vcn = "5"

LAYERSERIES_COMPAT_intel-vcn = "zeus"
LAYERDEPENDS_intel-vcn = " \
	core \
	yocto \
	openembedded-layer \
	networking-layer \
	filesystems-layer \
	meta-python \
	perl-layer \
	security \
	tpm-layer \
	virtualization-layer \
	intel \
	intel-snr \
"

# We have a pre-populated downloads directory, add to PREMIRRORS
PREMIRRORS_prepend := "\
     file://.*/.* file://${LAYERDIR}/downloads/ \n \
     git://.*/.* git:///${LAYERDIR}/downloads/MIRRORNAME;protocol=file \n \
     git://.*/.* file://${LAYERDIR}/downloads/ \n \
     svn://.*/.* file://${LAYERDIR}/downloads/ \n \
     ftp://.*/.* file://${LAYERDIR}/downloads/ \n \
     http://.*/.* file://${LAYERDIR}/downloads/ \n \
     https://.*/.* file://${LAYERDIR}/downloads/ \n"
```
